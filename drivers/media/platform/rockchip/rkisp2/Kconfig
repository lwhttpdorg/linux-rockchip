## drivers/media/platform/rockchip/rkisp2/Kconfig
```kconfig
# SPDX-License-Identifier: GPL-2.0
config VIDEO_ROCKCHIP_ISP
	tristate "Rockchip RK356x Image Signal Processing Unit driver"
	depends on V4L_PLATFORM_DRIVERS
	depends on VIDEO_DEV
	depends on ARCH_ROCKCHIP || COMPILE_TEST
	select MEDIA_CONTROLLER
	select VIDEO_V4L2_SUBDEV_API
	select VIDEOBUF2_DMA_CONTIG
	select VIDEOBUF2_DMA_SG
	select VIDEOBUF2_VMALLOC
	select V4L2_FWNODE
	select PHY_ROCKCHIP_CSI2_DPHY
	default n
	help
	  Support for the Rockchip ISP2.1 block found in RK3566 and
	  RK3568 SoCs.  This is a forward port of Rockchip's 6.1 BSP
	  driver and is independent of the upstream Rockchip ISP1 driver.

if VIDEO_ROCKCHIP_ISP

config VIDEO_ROCKCHIP_ISP_VERSION_V21
	bool
	default y

endif
```

## drivers/video/rockchip/Kconfig
```kconfig
# SPDX-License-Identifier: GPL-2.0
source "drivers/video/rockchip/mpp/Kconfig"
source "drivers/video/rockchip/mpp_osal/Kconfig"
```
